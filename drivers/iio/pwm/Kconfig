## drivers/iio/pwm/Kconfig
```kconfig
# SPDX-License-Identifier: GPL-2.0-only
#
# PWM drivers
#
# When adding new entries keep the list in alphabetical order

menu "Pulse Width Modulation"

config AXI_PWM_LED
	tristate "Analog Devices PWM to LED driver"
	help
	  Say yes here to build support for Analog Devices ONE_BIT_ADC_DAC
	  driver.

 	  To compile this driver as a module, choose M here: the
	  module will be called one-bit-adc-dac.

endmenu
```
