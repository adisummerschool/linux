// SPDX-License-Identifier: GPL-2.0
#include "versatile-pb.dts"

/ {
	spi_adi_emu@0 {
		compatible = "adi,spi-adi-emu";
		#address-cells = <1>;
		#size-cells = <0>;
		iio_adc_emu@0 {
			reg = <0>;
			spi-max-frequency = <10000000>;
			compatible = "iio_adc_emu";

		};
	};
};
