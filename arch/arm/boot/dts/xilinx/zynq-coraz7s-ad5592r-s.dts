
/dts-v1/;
//#include "zynq-coraz7s.dtsi"
#include "zynq-cora7s-axi-pwm-led.dts"

&spi0 {
    status = "okay";
    iio_ad5592r_s: spi@0 {
        reg = <0>;
        spi-max-frequency = <10000000>;
        compatible = "iio_ad5592r_s";
        spi-cpol;
    };
};

