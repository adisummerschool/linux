// SPDX-License-Identifier: GPL-2.0
/*
*ANALOG DEVICES AD5592R
*Copyright (C) 2025 Analog Devices,Inc.
*/
/dts-v1/;
#include "zynq-cora7s-axi-pwm-led.dts"

&spi0{

	status = "okay";
	ad5592r_s:spi@0{
		reg = <0>;
		spi-max-frequency = <10000000>;
		compatible = "iio_ad5592r_s";
		spi-cpol;
	};
};

